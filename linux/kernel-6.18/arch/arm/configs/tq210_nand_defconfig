## u-boot/mainline/arch/arm/mach-s5pc1xx/Kconfig
```kconfig
if ARCH_S5PC1XX

choice
	prompt "S5PC1XX board select"
	default TARGET_S5P_GONI

config TARGET_S5P_GONI
	bool "S5P Goni board"
	select OF_CONTROL
	select MISC_COMMON
	select MMC

endchoice

config SYS_SOC
	default "s5pc1xx"

source "board/samsung/goni/Kconfig"

endif
```

## u-boot/mainline/configs/tq210_defconfig
```kconfig
CONFIG_ARM=y
CONFIG_ARCH_CPU_INIT=y
CONFIG_ARCH_S5PC1XX=y
CONFIG_TARGET_TQ210=y
CONFIG_TEXT_BASE=0x24000000
CONFIG_SYS_MALLOC_LEN=0x400000
CONFIG_SYS_MALLOC_F_LEN=0x4000
CONFIG_NR_DRAM_BANKS=2
CONFIG_HAS_CUSTOM_SYS_INIT_SP_ADDR=y
CONFIG_CUSTOM_SYS_INIT_SP_ADDR=0x23000000
CONFIG_SKIP_LOWLEVEL_INIT_ONLY=y
# CONFIG_SYS_DCACHE_OFF is not set
CONFIG_SYS_ARM_MMU=y
CONFIG_DEFAULT_DEVICE_TREE="s5pv210-tq210"
CONFIG_SYS_MONITOR_LEN=524288
CONFIG_SYS_LOAD_ADDR=0x26000000
CONFIG_ENV_SIZE=0x1000
CONFIG_ENV_IS_NOWHERE=y
CONFIG_AUTOBOOT=y
CONFIG_BOOTDELAY=2
CONFIG_USE_BOOTCOMMAND=y
CONFIG_BOOTCOMMAND="tqboot"
CONFIG_USE_BOOTARGS=y
CONFIG_BOOTARGS="console=ttySAC0,115200n8 earlycon ignore_loglevel clk_ignore_unused rdinit=/init"
CONFIG_FIT=y
CONFIG_FIT_VERBOSE=y
CONFIG_SHA256=y
CONFIG_CMD_BOOTM=y
CONFIG_HUSH_PARSER=y
CONFIG_SYS_PROMPT="TQ210 => "
CONFIG_CMD_BOOTZ=y
CONFIG_CMD_CACHE=y
CONFIG_NO_NET=y
# CONFIG_MMC is not set
CONFIG_MTD=y
CONFIG_MTD_RAW_NAND=y
CONFIG_NAND_TQ210_RO=y
CONFIG_CMD_NAND=y
CONFIG_CMD_MTD=y
CONFIG_MTDIDS_DEFAULT="nand0=nand0"
CONFIG_MTDPARTS_DEFAULT="mtdparts=nand0:32m(boot-reserved)ro,992m(ubi-data)ro"
CONFIG_USB=y
CONFIG_USB_GADGET=y
# CONFIG_DM_USB_GADGET is not set
CONFIG_USB_GADGET_MANUFACTURER="TQ210"
CONFIG_USB_GADGET_VENDOR_NUM=0x1209
CONFIG_USB_GADGET_PRODUCT_NUM=0x0001
CONFIG_USB_GADGET_DWC2_OTG=y
# CONFIG_USB_GADGET_DWC2_OTG_PHY is not set
CONFIG_USB_GADGET_DOWNLOAD=y
CONFIG_USB_FUNCTION_FASTBOOT=y
CONFIG_CMD_FASTBOOT=y
CONFIG_FASTBOOT_BUF_ADDR=0x26000000
CONFIG_FASTBOOT_BUF_SIZE=0x4000000
# CONFIG_FASTBOOT_FLASH is not set
# CONFIG_FASTBOOT_OEM_RUN is not set
# CONFIG_FASTBOOT_UUU_SUPPORT is not set
# CONFIG_USB_STORAGE is not set
# CONFIG_USB_FUNCTION_MASS_STORAGE is not set
# CONFIG_EFI_LOADER is not set
CONFIG_DEBUG_UART=y
CONFIG_DEBUG_UART_S5P=y
CONFIG_DEBUG_UART_BASE=0xe2900000
CONFIG_DEBUG_UART_CLOCK=66700000
CONFIG_DEBUG_UART_SKIP_INIT=y
CONFIG_DEBUG_UART_ANNOUNCE=y
CONFIG_BAUDRATE=115200
```
